## config/west.yml
```yaml
manifest:
  remotes:
    - name: zmkfirmware
      url-base: https://github.com/zmkfirmware
    - name: rygwdn
      url-base: https://github.com/rygwdn
    - name: urob
      url-base: https://github.com/urob
  projects:
    - name: zmk
      # remote: zmkfirmware
      # revision: main
      remote: rygwdn
      revision: ignore-idle-key-positions
      import: app/west.yml
    - name: zmk-tri-state
      remote: urob
      revision: v0.2.1
  self:
    path: config
```
